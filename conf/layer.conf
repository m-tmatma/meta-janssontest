## conf/layer.conf
```bitbake
# We have a conf and classes directory, add to BBPATH
BBPATH .= ":${LAYERDIR}"

# We have recipes-* directories, add to BBFILES
BBFILES += "${LAYERDIR}/recipes-*/*/*.bb \
            ${LAYERDIR}/recipes-*/*/*.bbappend"

BBFILE_COLLECTIONS += "meta-janssontest"
BBFILE_PATTERN_meta-janssontest = "^${LAYERDIR}/"
BBFILE_PRIORITY_meta-janssontest = "6"

LAYERDEPENDS_meta-janssontest = "core"
LAYERSERIES_COMPAT_meta-janssontest = "dunfell"
```
